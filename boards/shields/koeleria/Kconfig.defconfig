## boards/shields/koeleria/Kconfig.defconfig
```kconfig
if SHIELD_KOELERIA_LEFT

# Name must be less than 16 characters long!
config ZMK_KEYBOARD_NAME
    default "koeleria"

config ZMK_SPLIT_ROLE_CENTRAL
    default y

endif

if SHIELD_KOELERIA_LEFT || SHIELD_KOELERIA_RIGHT

config ZMK_SPLIT
    default y

endif
```

## boards/shields/koeleria/Kconfig.shield
```kconfig
# No whitespace after the comma or in your part name!
config SHIELD_KOELERIA_LEFT
    def_bool $(shields_list_contains,koeleria_left)

# No whitespace after the comma or in your part name!
config SHIELD_KOELERIA_RIGHT
    def_bool $(shields_list_contains,koeleria_right)
```
